//--------------------------------------------------------------------------------------------------------------------------------
/*
 
 Тестовая прошивка для проверки работоспособности наколенного кода для китайского модуля CH376S.
 Модуль подключён к Serial1, можно подключать через SoftwareSerial. Тестировал только на скорости 9600.
 
 Пины подключения - смотри в папке Schematic. 

 Методы и вот это вот всё - в файле CH376S.h, другой документации - пока нет.
 
 */
//--------------------------------------------------------------------------------------------------------------------------------
#include "CH376S.h"
CH376S_UART USBDisk(Serial1);
//--------------------------------------------------------------------------------------------------------------------------------
void setup()
{
  Serial.begin(9600);
  Serial1.begin(9600);

  if(USBDisk.begin())
  {
      String fileName = "TEST.TXT"; // имя файла на флешке
      
      if(USBDisk.isFlashDriveInserted()) // если флешка вставлена
      {
          USBFile f = USBDisk.open(fileName);
          if(f.isOpen())
          {
              Serial.print(F("File size: "));
              Serial.println(f.size());
              Serial.println(F("Content of \"TEST.TXT\": "));
  
            while(f.available())
            {
              char ch = (char) f.read();
              if(ch == 0)
              {
                break;
              }

              Serial.print(ch);
            }
            
            f.close();
          }
          
      }
  }
}
//--------------------------------------------------------------------------------------------------------------------------------
void loop()
{
  
}
//--------------------------------------------------------------------------------------------------------------------------------

